## Kconfig
```kconfig
#
# For a description of the syntax of this configuration file,
# see the file kconfig-language.txt in the NuttX tools repository.
#

comment "Wi-Fi Support"
config WIFI
	bool "Wi-Fi Support"
	default n
	---help---
		Enable Wi-Fi Support.

if WIFI

config WIFI_STA
	bool "STA mode"
	default n
	---help---
		Enable support of Wi-Fi STA mode.

config WIFI_AP
	bool "AP mode"
	default n
	---help---
		Enable support of Wi-Fi AP mode.

endif
```
